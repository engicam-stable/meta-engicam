## conf/machine/include/iCoreM6SX.inc
```bitbake
# Provides the iCore6SX common settings

include conf/machine/include/tune-cortexa9.inc
include conf/machine/include/imx-base.inc

IMAGE_FSTYPES = "tar.bz2 ext4 sdcard"

SERIAL_CONSOLE = "115200 ttymxc0"

MACHINE_FEATURES += "wifi"
KERNEL_IMAGETYPE = "uImage"

PREFERRED_PROVIDER_virtual/kernel = "engicam-linux-fslc"
PREFERRED_PROVIDER_u-boot = "u-boot-eng"
PREFERRED_PROVIDER_virtual/bootloader = "u-boot-eng"

UBOOT_CONFIG ?= "sd"

UBI_VOLNAME ?= "rootfs"
```

## conf/machine/include/iCoreRQSM6.inc
```bitbake
# Provides the iCore6 common settings for RQS

require conf/machine/include/tune-cortexa9.inc
include conf/machine/include/iCore.inc
```

## conf/machine/isiot-geamx6ul.conf
```bitbake
#@TYPE: Machine
#@NAME: engicam isIoT based on geamx6 ultralite
#@SOC: i.MX6UL
#@DESCRIPTION: Machine configuration for Engicam geam6ul

include conf/machine/include/geamx6.inc

KERNEL_DEVICETREE = "isiot-imx6ul.dtb isiot-imx6ul-emmc.dtb"

UBOOT_CONFIG[sd] = "isiot_sd_defconfig,sdcard"
UBOOT_CONFIG[emmc] = "isiot_emmc_defconfig,sdcard"
UBOOT_CONFIG[nand] = "isiot_nand_defconfig"

MACHINEOVERRIDES =. "mx6:mx6ul:isiot:"
```

## conf/machine/microdev-y1.conf
```bitbake
#@TYPE: Machine
#@NAME: engicam geam6 ultralite
#@SOC: i.MX6UL
#@DESCRIPTION: Machine configuration for Engicam geam6ul

include conf/machine/include/geamx6.inc

UBINIZE_ARGS = "-m 2048 -p 128KiB -s 2048"
MKUBIFS_ARGS = "-m 2048 -e 126976 -c 1944"

MACHINEOVERRIDES =. "mx6:mx6ull:gea:microdev:"

KERNEL_DEVICETREE = "microgea-y1-microdev.dtb"

UBOOT_CONFIG ??= "sd"
UBOOT_CONFIG[sd] = "microgea_y1_sd_defconfig,sdcard"
UBOOT_CONFIG[nand] = "microgea_y1_nand_defconfig"

SERIAL_CONSOLE = "115200 ttymxc0"
```

## conf/machine/microdev.conf
```bitbake
#@TYPE: Machine
#@SOC: i.MX6ULL
#@NAME: engicam microdev
#@DESCRIPTION: Machine configuration for Engicam microdev

include conf/machine/include/geamx6.inc

UBINIZE_ARGS = "-m 2048 -p 128KiB -s 2048"
MKUBIFS_ARGS = "-m 2048 -e 126976 -c 1944"


KERNEL_DEVICETREE = "microgea-mx6ull-microdev.dtb microgea-mx6ull-microdev-yes7.dtb"

UBOOT_CONFIG ??= "sd"
UBOOT_CONFIG[sd] = "microgea_mx6ull_sd_defconfig,sdcard"
UBOOT_CONFIG[nand] = "microgea_mx6ull_nand_defconfig"

SERIAL_CONSOLE = "115200 ttymxc0"

MACHINE_FIRMWARE_append = " firmware-imx-epdc "

MACHINEOVERRIDES =. "mx6:mx6ull:gea:microdev"
```

## conf/machine/microgea.conf
```bitbake
#@TYPE: Machine
#@NAME: engicam microgea  Evaluation Kit
#@SOC: i.MX6ULL
#@DESCRIPTION: Machine configuration for engicam microgea mx6ull
#@MAINTAINER: Daiane Angolini <support@engicam.com>

MACHINEOVERRIDES =. "mx6:mx6ul:mx6ull:microdev:"

include conf/machine/include/imx-base.inc
include conf/machine/include/tune-cortexa7.inc

MACHINE_FIRMWARE_append = " firmware-imx-epdc"

KERNEL_DEVICETREE = " microgea-mx6ull.dtb "

UBOOT_CONFIG ??= "sd"
UBOOT_CONFIG[sd] = "microgea_mx6ull_sd_defconfig,sdcard"
UBOOT_CONFIG[nand] = "microgea_mx6ull_nand_defconfig"

PREFERRED_PROVIDER_u-boot_microdev = "u-boot-engicam"
PREFERRED_PROVIDER_virtual/bootloader_microdev = "u-boot-engicam"
PREFERRED_PROVIDER_virtual/kernel_microdev = "linux-engicam"

SERIAL_CONSOLES = "115200;ttymxc0"

MACHINE_FEATURES += "wifi bluetooth"

DEFCONFIG     = "microgea_mx6ull_defconfig"

IMAGE_BOOT_FILES = "${KERNEL_IMAGETYPE} ${KERNEL_DEVICETREE}"
```

## conf/machine/rqsm6dual.conf
```bitbake
#@TYPE: Machine
#@NAME: engicam iCoreM6 Dual
#@SOC: i.MX6Q
#@DESCRIPTION: Machine configuration for Engicam iCoreM6 Dual (RQS)

require conf/machine/include/iCoreRQSM6.inc

SOC_FAMILY = "mx6:mx6q"

KERNEL_DEVICETREE = "icorem6q-starterkit-rqs.dtb"

UBOOT_CONFIG[sd] = "icorem6drqs_mmc_config, sdcard" 
UBOOT_CONFIG[emmc] = "icorem6drqs_emmc_config, ubifs"
```

## conf/machine/rqsm6duallite.conf
```bitbake
#@TYPE: Machine
#@NAME: engicam iCoreM6 Solo
#@SOC: i.MX6DL
#@DESCRIPTION: Machine configuration for Engicam iCoreM6 Duallite (RQS)

require conf/machine/include/iCoreRQSM6.inc

SOC_FAMILY = "mx6:mx6dl"

KERNEL_DEVICETREE = "icorem6dl-starterkit-rqs.dtb"

UBOOT_CONFIG[sd] = "icorem6dlrqs_mmc_config, sdcard" 
UBOOT_CONFIG[emmc] = "icorem6dlrqs_emmc_config, ubifs"
```

## conf/machine/rqsm6quad.conf
```bitbake
#@TYPE: Machine
#@NAME: engicam iCoreM6 Quad
#@SOC: i.MX6Q
#@DESCRIPTION: Machine configuration for Engicam iCoreM6 Quad (RQS)

require conf/machine/include/iCoreRQSM6.inc

SOC_FAMILY = "mx6:mx6q"

KERNEL_DEVICETREE = "icorem6q-starterkit-rqs.dtb"

UBOOT_CONFIG[sd] = "icorem6qrqs_mmc_config, sdcard" 
UBOOT_CONFIG[emmc] = "icorem6qrqs_emmc_config, ubifs"
```

## conf/machine/rqsm6solo.conf
```bitbake
#@TYPE: Machine
#@NAME: engicam iCoreM6 Solo
#@SOC: i.MX6S
#@DESCRIPTION: Machine configuration for Engicam iCoreM6 Solo (RQS)

require conf/machine/include/iCoreRQSM6.inc

SOC_FAMILY = "mx6:mx6dl"

KERNEL_DEVICETREE = "icorem6dl-starterkit-rqs.dtb"

UBOOT_CONFIG[sd] = "icorem6srqs_mmc_config, sdcard" 
UBOOT_CONFIG[emmc] = "icorem6srqs_emmc_config, ubifs"
```

## conf/machine/smarc6soloxdg.conf
```bitbake
#@TYPE: Machine
#@NAME: Engicam iCoreM6 SoloX
#@SOC: i.MX6SX
#@DESCRIPTION: Machine configuration for Engicam iCoreM6 SoloX

include conf/machine/include/imx-base.inc
include conf/machine/include/tune-cortexa9.inc

SOC_FAMILY = "mx6:mx6sx"

MKUBIFS_ARGS = "-m 4096 -e 253952 -c 1996"
UBINIZE_ARGS = "-m 4096 -p 262144 -s 4096"
UBI_VOLNAME = "rootfs"

KERNEL_DEVICETREE = "imx6sx-smarcore.dtb"

UBOOT_ENTRYPOINT = "0x80008000"

SERIAL_CONSOLE = "115200 ttymxc0"

MACHINE_FEATURES += " pci wifi bluetooth"

MACHINE_FIRMWARE += " linux-firmware-ath6k"

UBOOT_CONFIG = "sd"
UBOOT_CONFIG[sd] = "smarcore_mx6sx_2G_config,sdcard"
UBOOT_CONFIG[nand] = "smarcore_mx6sx_2G_config,ubifs"
 
```

## tools/meta-example/conf/machine/example-imx6s.conf
```bitbake
#@TYPE: Machine
#@NAME: Examples Engicam iCoreM6 Solo
#@SOC: i.MX6S
#@DESCRIPTION: Machine configuration for custom Example board based on Engicam iCoreM6 

require conf/machine/include/iCoreM6.inc

SOC_FAMILY = "mx6:mx6dl:mx6s"

KERNEL_DEVICETREE = "imx6dl-examples.dtb"

PREFERRED_PROVIDER_u-boot = "u-boot-imx"
PREFERRED_PROVIDER_virtual/bootloader = "u-boot-imx"
 
UBOOT_CONFIG[sd] = "mx6s_example_sd_config,sdcard" 
UBOOT_CONFIG[nand] = "mx6s_example_config,ubifs"

UBI_VOLNAME = "rootfs"

# Enable for 256MB NAND size
UBINIZE_ARGS = "-m 2048 -p 128KiB -s 2048"
MKUBIFS_ARGS = "-m 2048 -e 126976 -c 1944"

# Enable for 512MB NAND size
#MKUBIFS_ARGS = "-m 4096 -e 253952 -c 1996"
#UBINIZE_ARGS = "-m 4096 -p 262144 -s 4096"
 
```

## tools/meta-example/conf/machine/example.conf
```bitbake
#@TYPE: Machine
#@NAME: engicam geam6 ultralite
#@SOC: i.MX6UL
#@DESCRIPTION: Machine configuration for Engicam geam6ul

require conf/machine/include/imx-base-eng.inc
require conf/machine/include/tune-cortexa7.inc

UBINIZE_ARGS = "-m 2048 -p 128KiB -s 2048"
MKUBIFS_ARGS = "-m 2048 -e 126976 -c 1944"
UBI_VOLNAME = "rootfs"

SOC_FAMILY = "mx6ul"

KERNEL_DEVICETREE = " imx6ul-gea.dtb \
		imx6ul-gea-lococap-7.dtb \
		imx6ul-gea-loco7.dtb \
		imx6ul-gea-loco43.dtb \
		"

PREFERRED_PROVIDER_u-boot = "u-boot-eng"
PREFERRED_PROVIDER_virtual/bootloader = "u-boot-eng"
UBOOT_MAKE_TARGET = "u-boot.imx"

PREFERRED_PROVIDER_virtual/kernel =  "linux-geam6ul"

UBOOT_CONFIG ??= "sd"
UBOOT_CONFIG[sd] = "geam6ul_mmc_defconfig,sdcard"
UBOOT_CONFIG[nand] = "geam6ul_nand_defconfig"

KERNEL_IMAGETYPE = "uImage"
IMAGE_FSTYPES = "ubifs sdcard"

SDCARD_GENERATION_COMMAND = "generate_imx_sdcard"
UBOOT_ENTRYPOINT = "0x80008000"

IMAGE_FSTYPES = "sdcard ubifs tar.bz2"
```

## tools/meta-example/conf/machine/include/geamx6.inc
```bitbake
# Provides the geamx6 common settings


include conf/machine/include/imx-base.inc
include conf/machine/include/tune-cortexa7.inc


IMAGE_FSTYPES = "tar.bz2 ext4 sdcard"

MACHINE_FEATURES += "wifi"
KERNEL_IMAGETYPE = "zImage"

PREFERRED_PROVIDER_virtual/kernel = "linux-engicam-imx"
PREFERRED_PROVIDER_u-boot = "u-boot-eng"
PREFERRED_PROVIDER_virtual/bootloader = "u-boot-eng"

UBOOT_CONFIG ?= "sd"

UBINIZE_ARGS = "-m 2048 -p 128KiB -s 2048"
MKUBIFS_ARGS = "-m 2048 -e 126976 -c 1944"
UBI_VOLNAME = "rootfs"

MACHINEOVERRIDES =. "mx6:mx6ul:"

SERIAL_CONSOLE ?= "115200 ttymxc0"
```

## tools/meta-example/conf/machine/include/iCore.inc
```bitbake
# Provides the iCore6 common settings

require conf/machine/include/imx-base.inc
require conf/machine/include/tune-cortexa9.inc

SDCARD_ROOTFS = "${DEPLOY_DIR_IMAGE}/${IMAGE_NAME}.rootfs.ext4"
IMAGE_FSTYPES = "tar.bz2 ext4 sdcard"

SERIAL_CONSOLE = "115200 ttymxc3"

MACHINE_FEATURES += "wifi"
KERNEL_IMAGETYPE = "uImage"

PREFERRED_PROVIDER_virtual/kernel ?= "linux-icore"

PREFERRED_PROVIDER_u-boot ?= "u-boot-eng"
PREFERRED_PROVIDER_virtual/bootloader ?= "u-boot-eng"

UBOOT_CONFIG ?= "sd"

UBI_VOLNAME ?= "rootfs"
```

## tools/meta-example/conf/machine/include/iCoreM6.inc
```bitbake
# Provides the iCore6 common settings

include conf/machine/include/tune-cortexa9.inc
include conf/machine/include/imx-base.inc

IMAGE_FSTYPES = "tar.bz2 ext4 sdcard"

SERIAL_CONSOLE = "115200 ttymxc3"

MACHINE_FEATURES += "wifi"
KERNEL_IMAGETYPE = "zImage"

PREFERRED_PROVIDER_virtual/kernel = "linux-engicam-imx"
PREFERRED_PROVIDER_u-boot = "u-boot-eng"
PREFERRED_PROVIDER_virtual/bootloader = "u-boot-eng"

UBOOT_CONFIG ?= "sd"

UBI_VOLNAME ?= "rootfs"
```

## tools/meta-example/conf/machine/include/iCoreRQSM6.inc
```bitbake
# Provides the iCore6 common settings for RQS

require conf/machine/include/tune-cortexa9.inc
include conf/machine/include/iCoreM6.inc
```
