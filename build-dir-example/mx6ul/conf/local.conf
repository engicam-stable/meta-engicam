## build-dir-example/mx6ul/conf/local.conf
```bitbake
MACHINE ??= 'geam6ul'
#MACHINE ??= 'imx6ulevk'
DISTRO ?= 'poky'
PACKAGE_CLASSES ?= "package_rpm"
EXTRA_IMAGE_FEATURES = "debug-tweaks"
USER_CLASSES ?= "buildstats image-mklibs image-prelink"
PATCHRESOLVE = "noop"
BB_DISKMON_DIRS = "\
    STOPTASKS,${TMPDIR},1G,100K \
    STOPTASKS,${DL_DIR},1G,100K \
    STOPTASKS,${SSTATE_DIR},1G,100K \
    ABORT,${TMPDIR},100M,1K \
    ABORT,${DL_DIR},100M,1K \
    ABORT,${SSTATE_DIR},100M,1K" 
PACKAGECONFIG_append_pn-qemu-native = " sdl"
PACKAGECONFIG_append_pn-nativesdk-qemu = " sdl"
ASSUME_PROVIDED += "libsdl-native"
CONF_VERSION = "1"

BB_NUMBER_THREADS = '32'
PARALLEL_MAKE = '-j 4'

DL_DIR ?= "${BSPDIR}/downloads/"
ACCEPT_FSL_EULA = ""

DISTRO_FEATURES_remove = " x11 wayland "

PACKAGECONFIG_append = " tslib "
PACKAGECONFIG_append = " linuxfb "
```

## conf/machine/gealmx6ull.conf
```bitbake
#@TYPE: Machine
#@NAME: Gea lmx6ull 
#@SOC: i.MX6ULL
#@DESCRIPTION: Machine configuration for engicam Gea lmx6ull 

include conf/machine/include/tune-cortexa7.inc
include conf/machine/include/imx6ul-common.inc
include conf/machine/include/iCore.inc

MACHINE_FIRMWARE_append = " firmware-imx-epdc "

SOC_FAMILY = "mx6ul:mx6ull"

KERNEL_DEVICETREE = " geal-mx6ull-starterkit.dtb "

PREFERRED_PROVIDER_virtual/kernel =  "linux-engicam-imx"

UBOOT_CONFIG ??= "sd"
UBOOT_CONFIG[sd] = "geal_mx6ull_sd_defconfig,sdcard"
UBOOT_CONFIG[nand] = "geal_mx6ull_nand_defconfig"

SERIAL_CONSOLE = "115200 ttymxc0"
```

## conf/machine/geam6ul.conf
```bitbake
#@TYPE: Machine
#@NAME: engicam geam6 ultralite
#@SOC: i.MX6UL
#@DESCRIPTION: Machine configuration for Engicam geam6ul

require conf/machine/include/tune-cortexa7.inc
include conf/machine/include/iCore.inc

UBINIZE_ARGS = "-m 2048 -p 128KiB -s 2048"
MKUBIFS_ARGS = "-m 2048 -e 126976 -c 1944"
UBI_VOLNAME = "rootfs"

SOC_FAMILY = "mx6ul"

KERNEL_DEVICETREE = "imx6ul-gea.dtb imx6ul-gea-lococap-7.dtb \
                     imx6ul-gea-loco7.dtb imx6ul-gea-loco43.dtb"

PREFERRED_PROVIDER_virtual/kernel =  "linux-geam6ul"

UBOOT_CONFIG[sd] = "geam6ul_mmc_defconfig,sdcard"
UBOOT_CONFIG[nand] = "geam6ul_nand_defconfig"

IMAGE_FSTYPES = "ubifs sdcard tar.bz2"

SDCARD_GENERATION_COMMAND = "generate_imx_sdcard"
UBOOT_ENTRYPOINT = "0x80008000"

SERIAL_CONSOLE = "115200 ttymxc0"
```

## conf/machine/geamx6ul.conf
```bitbake
#@TYPE: Machine
#@NAME: engicam geam6 ultralite
#@SOC: i.MX6UL
#@DESCRIPTION: Machine configuration for Engicam geam6ul

require conf/machine/include/tune-cortexa7.inc
include conf/machine/include/iCore.inc

UBINIZE_ARGS = "-m 2048 -p 128KiB -s 2048"
MKUBIFS_ARGS = "-m 2048 -e 126976 -c 1944"
UBI_VOLNAME = "rootfs"

SOC_FAMILY = "mx6ul"

KERNEL_DEVICETREE = "geamx6ul-starterkit.dtb geamx6ul-starterkit-emmc.dtb geamx6ul-ofloco43.dtb \
		     geamx6ul-ofwi.dtb geamx6ul-ofloco7-cap.dtb geamx6ul-ofloco7-cap-emmc.dtb \
		     geamx6ul-ofloco7-res.dtb geamx6ul-starterkit-2eth.dtb geamx6ul-ofloco7-cap-goodix.dtb"

UBOOT_CONFIG[sd] = "geamx6ul_sd_defconfig,sdcard"
UBOOT_CONFIG[emmc] = "geamx6ul_emmc_defconfig,sdcard"
UBOOT_CONFIG[nand] = "geamx6ul_nand_defconfig"

IMAGE_FSTYPES = "ubifs sdcard tar.bz2"

SDCARD_GENERATION_COMMAND = "generate_imx_sdcard"

SERIAL_CONSOLE = "115200 ttymxc0"
```

## conf/machine/iCoreM6Quad.conf
```bitbake
#@TYPE: Machine
#@NAME: engicam iCoreM6 Quad
#@SOC: i.MX6Q
#@DESCRIPTION: Machine configuration for Engicam iCoreM6 

require conf/machine/include/iCoreM6.inc

SOC_FAMILY = "mx6:mx6q"

KERNEL_DEVICETREE = "imx6q-icore.dtb"

PREFERRED_PROVIDER_u-boot = "u-boot-imx"
PREFERRED_PROVIDER_virtual/bootloader = "u-boot-imx"

UBOOT_MACHINE = "mx6q_icore_config"
```

## conf/machine/icorem6dual.conf
```bitbake
#@TYPE: Machine
#@NAME: engicam iCoreM6 Dual
#@SOC: i.MX6D
#@DESCRIPTION: Machine configuration for Engicam iCoreM6 Dual

include conf/machine/include/iCoreM6.inc

SOC_FAMILY = "mx6:mx6q"

KERNEL_DEVICETREE = "icorem6q-ofres.dtb icorem6q-ofcap7.dtb \
                     icorem6q-ofcap10.dtb icorem6q-ofwi.dtb \
                     icorem6q-starterkit.dtb "

UBOOT_CONFIG[sd] = "icorem6d_mmc_defconfig, sdcard"
UBOOT_CONFIG[nand] = "icorem6d_nand_defconfig, ubifs"
```

## conf/machine/icorem6duallite.conf
```bitbake
#@TYPE: Machine
#@NAME: engicam iCoreM6 Duallite
#@SOC: i.MX6DL
#@DESCRIPTION: Machine configuration for Engicam iCoreM6 Duallite

include conf/machine/include/iCoreM6.inc

SOC_FAMILY = "mx6:mx6dl"

KERNEL_DEVICETREE = "icorem6dl-starterkit.dtb icorem6dl-ofres.dtb \
                     icorem6dl-ofcap7.dtb icorem6dl-ofcap7-amp.dtb icorem6dl-ofcap10.dtb \
                     icorem6dl-ofwi.dtb icorem6dl-ofloco10.dtb"

UBOOT_CONFIG[sd] = "icorem6dl_mmc_defconfig, sdcard"
UBOOT_CONFIG[nand] = "icorem6dl_nand_defconfig, ubifs"
```

## conf/machine/icorem6duallite1024.conf
```bitbake
#@TYPE: Machine
#@NAME: engicam iCoreM6 Duallite 1G
#@SOC: i.MX6DL
#@DESCRIPTION: Machine configuration for Engicam iCoreM6 Duallite 1G

include conf/machine/include/iCoreM6.inc

SOC_FAMILY = "mx6:mx6dl"

KERNEL_DEVICETREE = "icorem6dl-starterkit.dtb icorem6dl-ofres.dtb \
                     icorem6dl-ofcap7.dtb icorem6dl-ofcap10.dtb \
                     icorem6dl-ofwi.dtb icorem6dl-ofloco10.dtb"

UBOOT_CONFIG[sd] = "icorem6dl1024_mmc_config, sdcard" 
UBOOT_CONFIG[nand] = "icorem6dl1024_nand_config, ubifs"
```

## conf/machine/icorem6quad.conf
```bitbake
#@TYPE: Machine
#@NAME: engicam iCoreM6 Quad
#@SOC: i.MX6Q
#@DESCRIPTION: Machine configuration for Engicam iCoreM6 Quad

include conf/machine/include/iCoreM6.inc

SOC_FAMILY = "mx6:mx6q"

KERNEL_DEVICETREE = "icorem6q-ofres.dtb icorem6q-ofcap7.dtb \
                     icorem6q-ofcap10.dtb icorem6q-ofwi.dtb \
                     icorem6q-starterkit.dtb"

UBOOT_CONFIG[sd] = "icorem6q_mmc_defconfig, sdcard"
UBOOT_CONFIG[nand] = "icorem6q_nand_defconfig, ubifs"
```

## conf/machine/icorem6solo.conf
```bitbake
#@TYPE: Machine
#@NAME: engicam iCoreM6 Solo
#@SOC: i.MX6S
#@DESCRIPTION: Machine configuration for Engicam iCoreM6 Solo

include conf/machine/include/iCoreM6.inc

SOC_FAMILY = "mx6:mx6dl"

KERNEL_DEVICETREE = "icorem6dl-starterkit.dtb icorem6dl-ofres.dtb \
                     icorem6dl-ofcap7.dtb icorem6dl-ofcap7-amp.dtb icorem6dl-ofcap10.dtb \
                     icorem6dl-ofwi.dtb icorem6dl-ofloco10.dtb "

UBOOT_CONFIG[sd] = "icorem6s_mmc_defconfig, sdcard"
UBOOT_CONFIG[nand] = "icorem6s_nand_defconfig, ubifs"
```

## conf/machine/icorem6solo512.conf
```bitbake
#@TYPE: Machine
#@NAME: engicam iCoreM6 Solo 512M
#@SOC: i.MX6S
#@DESCRIPTION: Machine configuration for Engicam iCoreM6 Solo 512M

include conf/machine/include/iCoreM6.inc

SOC_FAMILY = "mx6:mx6dl"

KERNEL_DEVICETREE = "icorem6dl-starterkit.dtb icorem6dl-ofres.dtb \
                     icorem6dl-ofcap7.dtb icorem6dl-ofcap10.dtb \
                     icorem6dl-ofwi.dtb icorem6dl-ofloco10.dtb"

UBOOT_CONFIG[sd] = "icorem6s512_mmc_defconfig, sdcard"
UBOOT_CONFIG[nand] = "icorem6s512_nand_defconfig, ubifs"
```

## conf/machine/icorem6solox-m4-ddr.conf
```bitbake
#@TYPE: Machine
#@NAME: Engicam iCoreM6 SoloX
#@SOC: i.MX6SX
#@DESCRIPTION: Machine configuration for Engicam iCoreM6 SoloX with M4 (first 16Mb of DDR are assigned to M4)

include conf/machine/include/iCoreM6.inc

SOC_FAMILY = "mx6:mx6sx:mx6sxm4"

KERNEL_DEVICETREE = "imx6sx-icore.dtb imx6sx-icore-m4.dtb"

UBOOT_ENTRYPOINT_mx6sxm4 = "0x81008000"

UBOOT_CONFIG[sd] = "icorem6sx_mmc_defconfig, sdcard"
UBOOT_CONFIG[nand] = "icorem6sx_nand_defconfig, ubifs"

SERIAL_CONSOLE = "115200 ttymxc0"
```

## conf/machine/icorem6solox.conf
```bitbake
#@TYPE: Machine
#@NAME: Engicam iCoreM6 SoloX
#@SOC: i.MX6SX
#@DESCRIPTION: Machine configuration for Engicam iCoreM6 SoloX

include conf/machine/include/iCoreM6.inc

SOC_FAMILY = "mx6:mx6sx"

KERNEL_DEVICETREE = "imx6sx-icore.dtb imx6sx-icore-icu-10.dtb \ 
                     imx6sx-icore-icu-123hsxga.dtb"

UBOOT_CONFIG[sd] = "icorem6sx_mmc_defconfig, sdcard"
UBOOT_CONFIG[nand] = "icorem6sx_nand_defconfig, ubifs"

SERIAL_CONSOLE = "115200 ttymxc0"
```

## conf/machine/icoremx6dual.conf
```bitbake
#@TYPE: Machine
#@NAME: engicam iCoreM6 Dual
#@SOC: i.MX6D
#@DESCRIPTION: Machine configuration for Engicam iCoreM6 Dual

include conf/machine/include/iCoreM6.inc

SOC_FAMILY = "mx6:mx6q"

KERNEL_DEVICETREE = "icoremx6q-starterkit.dtb icoremx6q-ofres.dtb icoremx6q-ofcap7.dtb icoremx6q-ofcap10.dtb \ 
		     icoremx6q-ofcover10.dtb icoremx6q-ofcap15.dtb icoremx6q-icore-mipi.dtb"

UBOOT_CONFIG[sd] = "icoremx6qd_sd_defconfig, sdcard"
UBOOT_CONFIG[emmc] = "icoremx6qd_emmc_defconfig, sdcard"
UBOOT_CONFIG[nand] = "icoremx6qd_nand_defconfig, ubifs"
```

## conf/machine/icoremx6duallite.conf
```bitbake
#@TYPE: Machine
#@NAME: engicam iCoreM6 Duallite
#@SOC: i.MX6DL
#@DESCRIPTION: Machine configuration for Engicam iCoreM6 Duallite

MACHINEOVERRIDES =. "mx6:mx6dl:icoremx6:"

require conf/machine/include/imx-base.inc
require conf/machine/include/tune-cortexa9.inc

KERNEL_DEVICETREE = " icore-mx6dl-starterkit-cap.dtb "

#UBOOT_MACHINE ?= "icoremx6dl_sd_defconfig"
UBOOT_CONFIG ??= "sd"
UBOOT_CONFIG[sd] = "icoremx6dl_sd_defconfig,sdcard"

PREFERRED_PROVIDER_u-boot_icoremx6 = "u-boot-engicam"
PREFERRED_PROVIDER_virtual/bootloader_icoremx6 = "u-boot-engicam"
PREFERRED_PROVIDER_virtual/kernel_icoremx6 = "linux-engicam"

DEFCONFIG  = "icoremx6_defconfig"

SERIAL_CONSOLES = "115200;ttymxc3"

IMAGE_BOOT_FILES = "${KERNEL_IMAGETYPE} ${KERNEL_DEVICETREE}"
```

## conf/machine/icoremx6dualliterqs.conf
```bitbake
#@TYPE: Machine
#@NAME: engicam iCoreM6 Duallite
#@SOC: i.MX6DL
#@DESCRIPTION: Machine configuration for Engicam iCoreM6 Duallite

include conf/machine/include/iCoreRQSM6.inc

SOC_FAMILY = "mx6:mx6q"

KERNEL_DEVICETREE = " icoremx6dl-starterkit-rqs.dtb "

UBOOT_CONFIG[sd] = "icoremx6dlrqs_sd_defconfig, sdcard"
UBOOT_CONFIG[emmc] = "icoremx6dlrqs_emmc_defconfig, sdcard"
```

## conf/machine/icoremx6dualplus.conf
```bitbake
#@TYPE: Machine
#@NAME: engicam iCoreM6 Dual
#@SOC: i.MX6D
#@DESCRIPTION: Machine configuration for Engicam iCoreM6 Dual

include conf/machine/include/iCoreM6.inc

MKUBIFS_ARGS ?= "-m 4096 -e 253952 -c 1996"
UBINIZE_ARGS ?= "-m 4096 -p 262144 -s 4096"

IMAGE_FSTYPES = "tar.bz2 sdcard"

MACHINEOVERRIDES =. "mx6:mx6q:"

KERNEL_DEVICETREE = " icoremx6dp-starterkit.dtb "

UBOOT_CONFIG[sd] = "icoremx6dp_sd_defconfig, sdcard"
UBOOT_CONFIG[nand] = "icoremx6dp_sd_defconfig, ubifs"

KERNEL_DEFCONFIG = "icoremx6_defconfig"
```

## conf/machine/icoremx6dualrqs.conf
```bitbake
#@TYPE: Machine
#@NAME: engicam iCoreM6 Duallite
#@SOC: i.MX6DL
#@DESCRIPTION: Machine configuration for Engicam iCoreM6 Duallite

include conf/machine/include/iCoreRQSM6.inc

SOC_FAMILY = "mx6:mx6q"

KERNEL_DEVICETREE = " icoremx6q-starterkit-rqs.dtb "

UBOOT_CONFIG[sd] = "icoremx6qrqs_sd_defconfig, sdcard"
UBOOT_CONFIG[emmc] = "icoremx6qrqs_emmc_defconfig, sdcard"
```

## conf/machine/icoremx6quad.conf
```bitbake
#@TYPE: Machine
#@NAME: engicam iCoreM6 Quad
#@SOC: i.MX6Q
#@DESCRIPTION: Machine configuration for Engicam iCoreM6 Dual

include conf/machine/include/iCoreM6.inc

MACHINEOVERRIDES =. "mx6:mx6q:icoremx6:"

KERNEL_DEVICETREE = " icoremx6q-starterkit.dts icoremx6q-starterkit-cap.dts icoremx6q-ofcap7.dts icoremx6q-amp-ofcap7.dts icoremx6q-ofcap10.dts \
                      icoremx6q-ofcap10-emmc.dts icoremx6q-ofcap2-10.dts icoremx6q-ofcap10-digi.dts icoremx6q-ofcover10.dts icoremx6q-ofcapwi.dts \
                      icoremx6q-ofres.dts  icoremx6q-ofloco10.dts icoremx6q-ofcap15.dts "

UBOOT_CONFIG[sd] = "icoremx6qd_sd_defconfig, sdcard"
UBOOT_CONFIG[nand] = "icoremx6qd_nand_defconfig, ubifs"
```

## conf/machine/icoremx6solo.conf
```bitbake
#@TYPE: Machine
#@NAME: engicam iCoreMx6 solo
#@SOC: i.MX6DL
#@DESCRIPTION: Machine configuration for Engicam iCoreM6 solo

include conf/machine/include/iCoreM6.inc

MACHINEOVERRIDES =. "mx6:mx6dl:icoremx6:"

KERNEL_DEVICETREE = " icoremx6dl-starterkit.dts icoremx6dl-starterkit-cap.dts icoremx6dl-ofcap7.dts icoremx6dl-amp-ofcap7.dts icoremx6dl-ofcap10.dts \
                      icoremx6dl-ofcap10-emmc.dts icoremx6dl-ofcap2-10.dts icoremx6dl-ofcap10-digi.dts icoremx6dl-ofcover10.dts icoremx6dl-ofcapwi.dts \
                      icoremx6dl-ofres.dts  icoremx6dl-ofloco10.dts icoremx6dl-ofcap15.dts "
KERNEL_DEFCONFIG = "icoremx6_defconfig"
UBOOT_CONFIG[sd] = "icoremx6s_sd_defconfig, sdcard"
UBOOT_CONFIG[nand] = "icoremx6s_nand_defconfig, ubifs"
```

## conf/machine/icoremx6solox.conf
```bitbake
#@TYPE: Machine
#@NAME: engicam iCoreMx6 solox
#@SOC: i.MX6DL
#@DESCRIPTION: Machine configuration for Engicam iCoreM6 solo

include conf/machine/include/iCoreM6SX.inc

MKUBIFS_ARGS ?= "-m 4096 -e 253952 -c 1996"
UBINIZE_ARGS ?= "-m 4096 -p 262144 -s 4096"

IMAGE_FSTYPES = " ubifs sdcard"

MACHINEOVERRIDES =. "mx6:mx6sx:icoremx6sx:"

KERNEL_DEVICETREE = " imx6sx-icore.dtb imx6sx-icore-m4.dtb imx6sx-icore-cap.dtb"

KERNEL_DEFCONFIG = "icoremx6_defconfig"
UBOOT_CONFIG[sd] = "icoremx6solox_sd_defconfig, sdcard"
UBOOT_CONFIG[nand] = "icoremx6solox_nand_defconfig, ubifs"
```

## conf/machine/imx6sx-smarcore.conf
```bitbake
#@TYPE: Machine
#@NAME: Engicam SMARC iMX6SX
#@SOC: i.MX6SX
#@DESCRIPTION: Machine configuration for Engicam SMARC iMX6SX

include conf/machine/include/iCoreM6SX.inc

SERIAL_CONSOLE = "115200 ttymxc4"

IMAGE_FSTYPES = " sdcard"

PREFERRED_PROVIDER_virtual/kernel = "engicam-linux-fslc-smarc"

MACHINEOVERRIDES =. "mx6:mx6sx:smarcore:"

KERNEL_DEVICETREE = " imx6sx-smarcore.dtb imx6sx-smarcore-m4.dtb "

KERNEL_DEFCONFIG = "imx6sx_smarcore_defconfig"
UBOOT_CONFIG[sd] = "smarcorem6sx_sd_defconfig, sdcard"
UBOOT_CONFIG[emmc] = "smarcorem6sx_emmc_defconfig, sdcard"
```

## conf/machine/include/geamx6.inc
```bitbake
# Provides the geamx6 common settings


include conf/machine/include/imx-base.inc
include conf/machine/include/tune-cortexa7.inc


IMAGE_FSTYPES = "tar.bz2 ext4 sdcard ubifs"

MACHINE_FEATURES += "wifi"
KERNEL_IMAGETYPE = "uImage"

PREFERRED_PROVIDER_virtual/kernel = "engicam-linux-fslc"
PREFERRED_PROVIDER_u-boot = "u-boot-eng"
PREFERRED_PROVIDER_virtual/bootloader = "u-boot-eng"

UBOOT_CONFIG ?= "sd"

UBINIZE_ARGS = "-m 2048 -p 128KiB -s 2048"
MKUBIFS_ARGS = "-m 2048 -e 126976 -c 1944"
UBI_VOLNAME = "rootfs"

MACHINEOVERRIDES ?= "mx6:mx6ul:"

SERIAL_CONSOLE ?= "115200 ttymxc0"
```

## conf/machine/include/iCore.inc
```bitbake
# Provides the iCore6 common settings

require conf/machine/include/imx-base.inc

SDCARD_ROOTFS = "${DEPLOY_DIR_IMAGE}/${IMAGE_NAME}.rootfs.ext4"
IMAGE_FSTYPES = "tar.bz2 ext4 sdcard"

SERIAL_CONSOLE = "115200 ttymxc3"

MACHINE_FEATURES += "wifi"
KERNEL_IMAGETYPE = "uImage"

PREFERRED_PROVIDER_virtual/kernel ?= "linux-icore"

PREFERRED_PROVIDER_u-boot ?= "u-boot-eng"
PREFERRED_PROVIDER_virtual/bootloader ?= "u-boot-eng"

UBOOT_CONFIG ?= "sd"

UBI_VOLNAME ?= "rootfs"

PREFERRED_VERSION_imx-kobs_mx6ul  = "5.1"
PREFERRED_VERSION_imx-kobs_mx6  = "3.14.28%"
```

## conf/machine/include/iCoreM6.inc
```bitbake
# Provides the iCore6 common settings

include conf/machine/include/tune-cortexa9.inc
include conf/machine/include/imx-base.inc

MKUBIFS_ARGS ?= "${@bb.utils.contains('NANDREV', '2', '-m 2048 -e 126976 -c 3992', '-m 4096 -e 253952 -c 1996', d)}"
UBINIZE_ARGS ?= "${@bb.utils.contains('NANDREV', '2', '-m 2048 -p 131072 -s 2048', '-m 4096 -p 262144 -s 4096', d)}"

IMAGE_FSTYPES = "tar.bz2 ext4 sdcard ubifs"

SERIAL_CONSOLE = "115200 ttymxc3"

MACHINE_FEATURES += "wifi"
KERNEL_IMAGETYPE = "uImage"

PREFERRED_PROVIDER_virtual/kernel ??= "engicam-linux-fslc"
PREFERRED_PROVIDER_u-boot = "u-boot-eng"
PREFERRED_PROVIDER_virtual/bootloader = "u-boot-eng"

UBOOT_CONFIG ?= "sd"

UBI_VOLNAME ?= "rootfs"
```
